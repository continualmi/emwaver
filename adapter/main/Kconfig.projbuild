## adapter/main/Kconfig.projbuild
```kconfig
menu "Adapter Configuration"

    config EXAMPLE_EXTENDED_ADV
        bool
        depends on SOC_BLE_50_SUPPORTED && BT_NIMBLE_50_FEATURE_SUPPORT
        default y if SOC_ESP_NIMBLE_CONTROLLER
        select BT_NIMBLE_EXT_ADV
        prompt "Enable extended advertising"
        help
            Use this option to enable extended advertising.
            If this option is disabled, ensure config BT_NIMBLE_EXT_ADV is
            also disabled from Nimble stack menuconfig

    config ADAPTER_BLE_DEVICE_NAME
        string "BLE device name"
        default "BLE Waver Dongle"
        help
            GAP device name used in advertisements.

    config ADAPTER_USB_VID
        hex "USB CDC-ACM VID"
        default 0x0483
        help
            Vendor ID (VID) of the USB CDC-ACM device to connect to.

    config ADAPTER_USB_PID
        hex "USB CDC-ACM PID"
        default 0x5740
        help
            Product ID (PID) of the USB CDC-ACM device to connect to.

    config ADAPTER_USB_BAUD
        int "USB CDC-ACM baud rate"
        default 115200
        help
            Line coding baud rate to configure on the connected CDC-ACM device.

endmenu
```

## adapter/sdkconfig.defaults
```kconfig
# Override some defaults so BT stack is enabled
# in this example

#
# BT config
#
CONFIG_BT_ENABLED=y
CONFIG_BTDM_CTRL_MODE_BLE_ONLY=y
CONFIG_BTDM_CTRL_MODE_BR_EDR_ONLY=n
CONFIG_BTDM_CTRL_MODE_BTDM=n
CONFIG_BT_BLUEDROID_ENABLED=n
CONFIG_BT_NIMBLE_ENABLED=y

#
# Adapter defaults
#
CONFIG_ADAPTER_BLE_DEVICE_NAME="BLE Waver Dongle"
CONFIG_ADAPTER_USB_VID=0x0483
CONFIG_ADAPTER_USB_PID=0x5740
CONFIG_ADAPTER_USB_BAUD=115200
```

## esp/blink/main/Kconfig.projbuild
```kconfig
menu "Blink Configuration"

    config BLINK_GPIO
        int "Blink GPIO number"
        range 0 48
        default 10
        help
            GPIO number (IOxx) to blink on and off.

    config BLINK_PERIOD
        int "Blink period in ms"
        range 10 3600000
        default 1000
        help
            Blink period in milliseconds.

endmenu
```

## esp/esp8266/main/Kconfig.projbuild
```kconfig
menu "EMWaver ESP8266"

config EMWAVER_ESP8266_AP_PASSWORD
    string "SoftAP provisioning password"
    default ""
    help
        Optional WPA2 password for the fallback provisioning SoftAP.
        Leave empty for an open setup network during internal bring-up.

config EMWAVER_ESP8266_DEFAULT_LED_GPIO
    int "Startup LED GPIO"
    default 2
    range 0 16
    help
        GPIO toggled during startup. NodeMCU-style boards commonly use GPIO2.

config EMWAVER_ESP8266_SPI_MISO_GPIO
    int "Default HSPI MISO GPIO"
    default 12
    range 0 16

config EMWAVER_ESP8266_SPI_MOSI_GPIO
    int "Default HSPI MOSI GPIO"
    default 13
    range 0 16

config EMWAVER_ESP8266_SPI_SCK_GPIO
    int "Default HSPI SCK GPIO"
    default 14
    range 0 16

config EMWAVER_ESP8266_I2C_SDA_GPIO
    int "Default I2C SDA GPIO"
    default 4
    range 0 16

config EMWAVER_ESP8266_I2C_SCL_GPIO
    int "Default I2C SCL GPIO"
    default 5
    range 0 16

endmenu
```

## esp/esp8266/sdkconfig.defaults
```kconfig
CONFIG_FREERTOS_HZ=1000
CONFIG_ESP8266_DEFAULT_CPU_FREQ_80=y
CONFIG_ESP8266_DEFAULT_CPU_FREQ_MHZ=80
CONFIG_ESP8266_WIFI_AMPDU_RX_ENABLED=n
CONFIG_ESP8266_WIFI_AMPDU_TX_ENABLED=n
CONFIG_LWIP_SO_REUSE=y
CONFIG_ENABLE_MDNS=y
CONFIG_LWIP_IPV6=y
CONFIG_MDNS_MAX_SERVICES=2
CONFIG_MDNS_TASK_PRIORITY=1
CONFIG_MDNS_SERVICE_ADD_TIMEOUT_MS=2000
CONFIG_ESP_PHY_INIT_DATA_VDD33_CONST=33
```

## esp/main/Kconfig.projbuild
```kconfig
menu "EMWaver firmware"

config EMWAVER_ENABLE_WIFI_TRANSPORT
    bool "Enable EMWaver ESP32 Wi-Fi transport"
    default y
    help
        Enables the station-mode LAN-trust WebSocket transport used by
        EMWaver Wi-Fi provisioning and LAN/VPN script control.

endmenu
```

## esp/sdkconfig.defaults.esp32
```kconfig
CONFIG_BT_ENABLED=y
CONFIG_BTDM_CTRL_MODE_BLE_ONLY=y
# CONFIG_BTDM_CTRL_MODE_BR_EDR_ONLY is not set
# CONFIG_BTDM_CTRL_MODE_BTDM is not set
# CONFIG_BT_BLUEDROID_ENABLED is not set
CONFIG_BT_NIMBLE_ENABLED=y
CONFIG_BT_NIMBLE_ROLE_PERIPHERAL=y
CONFIG_BT_NIMBLE_ROLE_BROADCASTER=y
CONFIG_BT_NIMBLE_GATT_SERVER=y
CONFIG_BT_NIMBLE_ATT_PREFERRED_MTU=256
CONFIG_BT_NIMBLE_TRANSPORT_ACL_SIZE=255
# Classic ESP32 is tight on IRAM when Wi-Fi and NimBLE are both enabled.
# Keep throughput-oriented Wi-Fi/PHY paths in flash for this target profile.
# CONFIG_ESP_PHY_IRAM_OPT is not set
# CONFIG_ESP_WIFI_IRAM_OPT is not set
# CONFIG_ESP_WIFI_RX_IRAM_OPT is not set
```

## esp/sdkconfig.defaults.esp32s2
```kconfig
# ESP32-S2 has no Bluetooth radio; USB and Wi-Fi are the supported transports.
# CONFIG_BT_ENABLED is not set
```

## esp/sdkconfig.defaults.esp32s3
```kconfig
CONFIG_BT_ENABLED=y
CONFIG_BT_NIMBLE_ENABLED=y
CONFIG_BT_NIMBLE_ROLE_PERIPHERAL=y
CONFIG_BT_NIMBLE_ROLE_BROADCASTER=y
CONFIG_BT_NIMBLE_GATT_SERVER=y
CONFIG_BT_NIMBLE_ATT_PREFERRED_MTU=256
CONFIG_BT_NIMBLE_TRANSPORT_ACL_SIZE=255
```
